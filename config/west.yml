## config/west.yml
```yaml
manifest:
  remotes:
    - name: zmkfirmware
      url-base: https://github.com/zmkfirmware
    - name: flumelabs
      url-base: https://github.com/flumelabs
    - name: badjeff
      url-base: https://github.com/badjeff
  projects:
    - name: zmk
      remote: zmkfirmware
      revision: v0.3
      import: app/west.yml
    - name: zmk-eos-shield
      remote: flumelabs
      revision: main
    - name: zmk-output-behavior-listener
      remote: badjeff
      revision: 92415c7
    - name: zmk-split-peripheral-output-relay
      remote: badjeff
      revision: 014b549
    - name: zmk-drv2605-driver
      remote: badjeff
      revision: 81a386a
    - name: zmk-helpers
      url: https://github.com/urob/zmk-helpers
      revision: v0.3
    - name: zmk-rgbled-widget
      url: https://github.com/caksoylar/zmk-rgbled-widget
      revision: v0.3 
    - name: zmk-tri-state
      url: https://github.com/dhruvinsh/zmk-tri-state
      revision: ebbc1f0
    - name: zmk-deadkey-slayer
      url: https://github.com/ssbb/zmk-deadkey-slayer
      revision: v1
  self:
    path: config
```
